## combined-update/samples/u-boot-caps.its
```
/dts-v1/;

/ {
	description = "Automatic U-Boot environment update";
	#address-cells = <3>;

	images {
		boot.bin {
			description = "U-Boot binary on SPI Flash";
			data = /incbin/("boot.bin");
			compression = "none";
			type = "firmware";
			arch = "arm64";
			load = <0>;
			hash-1 {
				algo = "sha1";
			};
		};
		u-boot.itb {
			description = "U-Boot binary";
			data = /incbin/("u-boot.itb");
			compression = "none";
			type = "firmware";
			arch = "arm64";
			load = <0>;
			hash-1 {
				algo = "sha1";
			};
		};
	};
};
```
